## meta-heipc-examples/conf/layer.conf
```bitbake
# We have a conf and classes directory, add to BBPATH
BBPATH .= ":${LAYERDIR}"

# We have recipes-* directories, add to BBFILES
BBFILES += "${LAYERDIR}/recipes-*/*/*.bb \
	${LAYERDIR}/recipes-*/*/*.bbappend"

BBFILE_COLLECTIONS += "heipc-examples-layer"
BBFILE_PATTERN_heipc-examples-layer = "^${LAYERDIR}/"
BBFILE_PRIORITY_heipc-examples-layer = "11"

# This should only be incremented on significant changes that will
# cause compatibility issues with other layers
LAYERVERSION_heipc-examples-layer = "1"

#LAYERDEPENDS_heipc = "core" #?

LAYERSERIES_COMPAT_heipc-examples-layer = "scarthgap"
```
